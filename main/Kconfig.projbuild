## main/Kconfig.projbuild
```kconfig
menu "EchoLink Client"

    choice EL_BOARD
        prompt "Target board"
        default EL_BOARD_TDISPLAY_P4 if IDF_TARGET_ESP32P4
        default EL_BOARD_TDECK_PLUS if IDF_TARGET_ESP32S3
        help
            Selects the board support (pins, display, audio, storage). The
            ESP32-S3 boards share a target, so pick the one being built.

        config EL_BOARD_TDISPLAY_P4
            bool "LilyGO T-Display-P4"
            depends on IDF_TARGET_ESP32P4

        config EL_BOARD_TAB5
            bool "M5Stack Tab5"
            depends on IDF_TARGET_ESP32P4

        config EL_BOARD_TDECK_PLUS
            bool "LilyGO T-Deck Plus"
            depends on IDF_TARGET_ESP32S3

        config EL_BOARD_WIO_TRACKER_L2
            bool "Seeed Wio Tracker L2"
            depends on IDF_TARGET_ESP32S3
    endchoice

    config EL_USB_AUDIO
        bool "USB audio headset on the USB-A host port"
        depends on EL_BOARD_TAB5
        default y
        help
            Drives a USB audio class (UAC 1.0) headset or sound card plugged
            into the Tab5's USB-A port. While plugged in, its microphone
            replaces the built-in ones and its output replaces the speaker;
            each direction falls back on its own when the device is removed.

    config EL_CALLSIGN
        string "Default callsign"
        default ""
        help
            Your EchoLink-validated callsign. Can be changed at runtime with
            the console command "set callsign <CALL>" (stored in NVS).

    config EL_PASSWORD
        string "Default EchoLink password"
        default ""

    config EL_NAME
        string "Default operator name"
        default ""

    config EL_LOCATION
        string "Default location/description"
        default "Wio Tracker L2" if EL_BOARD_WIO_TRACKER_L2
        default "T-Deck Plus" if EL_BOARD_TDECK_PLUS
        default "Tab5" if EL_BOARD_TAB5
        default "T-Display-P4"
        help
            Shown in the EchoLink directory next to your callsign.

    config EL_DIRECTORY_SERVER
        string "Directory server"
        default "servers.echolink.org"

    config EL_WIFI_SSID
        string "Default Wi-Fi SSID"
        default ""

    config EL_WIFI_PASSWORD
        string "Default Wi-Fi password"
        default ""

    config EL_ACCEPT_INCOMING
        bool "Accept incoming connections by default"
        default y
        help
            Incoming connections are only accepted from stations present in
            the downloaded directory list, and only while idle. Stations
            behind NAT need UDP 5198-5199 forwarded to the device.

endmenu
```
